## sdkconfig.defaults
```kconfig
# General SOC Items
CONFIG_AWS_IOT_HARDWARE_PLATFORM_NAME="ESP32-S3"

# Flash Size
CONFIG_ESPTOOLPY_FLASHSIZE_DETECT=y
CONFIG_ESPTOOLPY_FLASHSIZE_16MB=y
CONFIG_ESPTOOLPY_FLASHSIZE="16MB"

# Time Zone
CONFIG_SNTP_TIME_ZONE="EST5EDT"

# FREERTOS
CONFIG_FREERTOS_TIMER_SERVICE_TASK_NAME="tmr_svc"
CONFIG_FREERTOS_TIMER_TASK_PRIORITY=3

# Stack Sizes
CONFIG_ESP_SYSTEM_EVENT_TASK_STACK_SIZE=4096
CONFIG_ESP_MAIN_TASK_STACK_SIZE=4096
CONFIG_ESP_IPC_TASK_STACK_SIZE=2048
CONFIG_ESP_TIMER_TASK_STACK_SIZE=3584
CONFIG_LWIP_TCPIP_TASK_STACK_SIZE=4096
CONFIG_FREERTOS_IDLE_TASK_STACKSIZE=2048

# Task Priorties
CONFIG_LWIP_TCPIP_TASK_PRIO=5

# PThreads
CONFIG_PTHREAD_TASK_PRIO_DEFAULT=3

# Wifi
CONFIG_ESP_WIFI_TASK_PINNED_TO_CORE_1=y

# Memory Settings
CONFIG_ESP32S3_SPIRAM_SUPPORT=y
CONFIG_SPIRAM_MODE_OCT=y
CONFIG_SPIRAM_TYPE_AUTO=y

# Partition Table
CONFIG_PARTITION_TABLE_CUSTOM=y
CONFIG_PARTITION_TABLE_FILENAME="partitions.csv"
CONFIG_PARTITION_TABLE_OFFSET=0xC000
```
